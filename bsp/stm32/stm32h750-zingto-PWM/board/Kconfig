## bsp/stm32/stm32h750-zingto-PWM/board/Kconfig
```kconfig
menu "Hardware Drivers Config"

config SOC_STM32H750VB
    bool
    select SOC_SERIES_STM32H7
    select RT_USING_COMPONENTS_INIT
    select RT_USING_USER_MAIN
    default y

menu "Onboard Peripheral Drivers"

endmenu

menu "On-chip Peripheral Drivers"

    config BSP_USING_GPIO
        bool "Enable GPIO"
        select RT_USING_PIN
        default y

    menuconfig BSP_USING_UART
        bool "Enable UART"
        default y
        select RT_USING_SERIAL
        if BSP_USING_UART
            config BSP_USING_UART1
                bool "Enable UART1"
                default y   
            config BSP_USING_UART4
                bool "Enable UART4"
                default y
            config BSP_USING_UART6
                bool "Enable UART6"
                default y 

        endif
	
	menuconfig BSP_USING_PWM
		bool "Enable pwm"
		default n
		select RT_USING_PWM
		if BSP_USING_PWM
		menuconfig BSP_USING_PWM2
			bool "Enable timer2 out pwm"
			default n
			if BSP_USING_PWM2
				config BSP_USING_PWM2_CH3
					bool "Enable PWM2 channel3"
					default n
			endif
		endif

    config BSP_USING_WDT
        bool "Enable Watchdog Timer"
        select RT_USING_WDT
        default y
        
    source "../libraries/HAL_Drivers/Kconfig"
    
endmenu

menu "Board extended module Drivers"

endmenu
 
endmenu
```
